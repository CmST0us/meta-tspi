## conf/machine/tspi-rk3566.conf
```bitbake
# Copyright (c) 2020, Rockchip Electronics Co., Ltd
# Released under the MIT license (see COPYING.MIT for the terms)

#@TYPE: Machine
#@NAME: RK3566 LCEDA Taishang Pi

require conf/machine/include/rk356x.inc

PREFERRED_VERSION_linux-rockchip = "6.1%"

LINUXLIBCVERSION = "6.1-custom%"

KERNEL_DEVICETREE = "rockchip/tspi-rk3566-user-v10-linux.dtb"

UBOOT_MACHINE = "rk3568_defconfig"

RK_WIFIBT_RRECOMMENDS = " \
	rkwifibt-firmware-ap6212a1-wifi \
	rkwifibt-firmware-ap6212a1-bt \
	brcm-tools \
"

MACHINE_EXTRA_RRECOMMENDS:append = " \
	drm-cursor \
"
```
